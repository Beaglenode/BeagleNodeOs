## meta-beaglenode/conf/layer.conf
```bitbake
# We have a conf and classes directory, add to BBPATH
BBPATH .= ":${LAYERDIR}"

# We have recipes-* directories, add to BBFILES
BBFILES += "${LAYERDIR}/recipes-*/*/*.bb \
            ${LAYERDIR}/recipes-*/*/*.bbappend"

BBFILE_COLLECTIONS += "meta-beaglenode"
BBFILE_PATTERN_meta-beaglenode = "^${LAYERDIR}/"
BBFILE_PRIORITY_meta-beaglenode = "6"

LAYERDEPENDS_meta-beaglenode = "core"
LAYERSERIES_COMPAT_meta-beaglenode = "kirkstone"

# Provide the build custom variables in here
MACHINE = "beaglebone"

IMAGE_FSTYPES += "wic"
IMAGE_INSTALL:append = " libgpiod libgpiod-tools i2c-tools"
IMAGE_FEATURES += " ssh-server-dropbear"

# Add extra 1 GB of space
IMAGE_ROOTFS_EXTRA_SPACE = "1024000" 

# extlinux.conf file modifications
UBOOT_EXTLINUX_FDT = "../am335x-bonegreen.dtb"
UBOOT_EXTLINUX_FDTOVERLAYS = "../beaglenode.dtbo"
```
